## Documentation/devicetree/bindings/mtd/mtk_nor.txt
```
* MTD SPI nor driver for MTK MT81xx (and similar) serial flash controller

Required properties:
- compatible: Should be "mediatek,mt8173-nor";
- reg: Physical base address and length of the controller's register
- clocks: spi nor source clock
- clock-names: "spi_clk", "axi_clk", "mux_clk", "sf_clk"
  See Documentation/devicetree/bindings/clock/clock-bindings.txt for details.

Example:
nor_flash: nor@1100d000 {
	compatible = "mediatek,mt8173-nor";
	reg = <0 0x1100D000 0 0xE0>;
	clocks = <&pericfg CLK_PERI_SPI>,
	<&topckgen CLK_TOP_AXI_SEL>,
	<&topckgen CLK_TOP_UNIVPLL2_D8>,
	<&topckgen CLK_TOP_SPINFI_IFR_SEL>;
	clock-names = "spi_clk", "axi_clk", "mux_clk", "sf_clk";
};
```
